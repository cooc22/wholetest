#include "stc89.h" 

void UARTInit(void) //定义串口初始化函数
{
SCON =0x50; //8 位数据位
TCON=0x10; //由T/C 作为波特率发生器
TL1=0xD9; //波特率为9600 的低8 位
TH1=0xFF; //波特率为9600 的高8 位
ES=1; //允许串口中断
EA=1; //允许全部中断
}
/****************************************
*函数名称:UARTSendByte
*输入:byte 要发送的字节
*输出:无
*功能:串口发送单个字节
******************************************/
void UARTSendByte(unsigned char byte)//定义串口发送数据函数
{
SBUF=byte; //缓冲区装载要发送的字节
while(TI==0); //等待发送完毕,TI 标志位会置1
TI=0; //清零发送完成标志位
}
/****************************************
*函数名称:main
*输入:无
*输出:无
*功能:函数主体
******************************************/
void Uart_Run(void) //主函数
{
UARTInit(); //串口初始化
while(1) //进入死循环
{;} //无操作
}
/****************************************
*函数名称:UartIRQ
*输入:无
*输出:无
*功能:串口中断服务函数
******************************************/
void UartIRQ(void) interrupt 4//中断服务函数
{
unsigned char recv; //声明变量recv
if(RI) //检测接收完成标志位置1
{
RI=0; //清零接收完成标志位
recv=SBUF; //读取接收到的数据
UARTSendByte(recv); //返回接收到的数据
}
}
