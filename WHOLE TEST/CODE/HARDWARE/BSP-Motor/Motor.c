/********************************************************************************
*  标题: 恒速运行                                                               *																				
*********************************************************************************
* 通过本例程了解PWM 的基本原理和使用 																									
*   请将直流电机线接在+5V P12对应的端子上(步进马达接口出)						                       	                                                       	                                   
*********************************************************************************/
#include <reg52.h>
unsigned char timer1; 
sbit PWM=P1^1;
void system_Ini()//定時器初始化
{
    TMOD= 0x11;//00010001 
	TH1 = 0xfe; //11.0592
	TL1 = 0x33;
	TR1  = 1; 
    IE =0x8A;//10001010	
}
 main()
{
  system_Ini();
  while(1)
  { if(timer1>100) timer1=0;
    if(timer1<30) PWM=0;
    else PWM=1;
  }
 }
/*************************************
 [ t1 (0.5ms)中断] 中断中做 PWM 输出
  ------------1000/(0.02ms*250)=200Hz
*************************************/
void T1zd(void) interrupt 3    
{
	TH1 = 0xfe; //11.0592
	TL1 = 0x33;
	 timer1++; 
}


